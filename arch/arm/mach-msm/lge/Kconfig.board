## arch/arm/mach-msm/lge/Kconfig.board
```kconfig
config MACH_MSM7X27_THUNDERC
	depends on ARCH_MSM7X27
	depends on !MSM_STACKED_MEMORY
	select MACH_LGE
	bool "MSM7x27 THUNDER Verizone"
	help
	  Support for the LGE MSM7x27 THUNDER Verizone board.
```
